## conf/layer.conf
```bitbake
# We have a conf and classes directory, add to BBPATH
BBPATH =. "${LAYERDIR}:"

# We have a packages directory, add to BBFILES
BBFILES += "${LAYERDIR}/recipes-*/*/*.bbappend"

BBFILE_COLLECTIONS += "host-fixes"
BBFILE_PATTERN_host-fixes = "^${LAYERDIR}/"
BBFILE_PRIORITY_host-fixes = "10"

LAYERSERIES_COMPAT_host-fixes = "thud"
```
